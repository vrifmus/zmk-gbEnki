## config/boards/shields/gbEnki/Kconfig.shield
```kconfig
# Copyright (c) 2020 Pete Johanson
# SPDX-License-Identifier: MIT

config SHIELD_GBENKI_LEFT
    def_bool $(shields_list_contains,gbEnki_left)

config SHIELD_GBENKI_RIGHT
    def_bool $(shields_list_contains,gbEnki_right)
```
